## conf/layer.conf
```bitbake
############################################################################
##
## This file is part of the Ecosysteme meta layer.
##
############################################################################

# We have a conf and classes directory, add to BBPATH
BBPATH .= ":${LAYERDIR}"

# We have recipes-* directories, add to BBFILES
BBFILES += "${LAYERDIR}/recipes-*/*/*.bb \
            ${LAYERDIR}/recipes-*/*/*.bbappend"

BBFILE_COLLECTIONS += "meta-ecosysteme"
BBFILE_PATTERN_meta-ecosysteme = "^${LAYERDIR}/"
BBFILE_PRIORITY_meta-ecosysteme = "25"

LAYERDEPENDS_meta-ecosysteme = "core"
LAYERSERIES_COMPAT_meta-ecosysteme = "warrior zeus"

# recipe appends for machine specific BSP layers
BBFILES_DYNAMIC += " \
    toradex-nxp-layer:${LAYERDIR}/dynamic-layers/toradex-nxp-layer/recipes*/*/*.bb \
    toradex-nxp-layer:${LAYERDIR}/dynamic-layers/toradex-nxp-layer/recipes*/*/*.bbappend \
"
```
